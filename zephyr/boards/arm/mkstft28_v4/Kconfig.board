## zephyr/boards/arm/mkstft28_v4/Kconfig.board
```kconfig
# STM32 Minimum Development Board Configuration

# Copyright (c) 2017, embedjournal.com
# SPDX-License-Identifier: Apache-2.0

config BOARD_BOARD_MKSTFT28_V4
	bool "STM32 Minimum Development Board (Black)"
	depends on SOC_STM32F107XC
```

## zephyr/boards/arm/mkstft28_v4/Kconfig.defconfig
```kconfig
# STM32 Minimum Development Board Configuration

# Copyright (c) 2017, embedjournal.com
# SPDX-License-Identifier: Apache-2.0

if BOARD_MKSTFT28_V4

config BOARD
	default "mkstft28_v4" if BOARD_MKSTFT28_V4

endif # BOARD_MKSTFT28_V4
```
